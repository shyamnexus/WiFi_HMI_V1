## sdkconfig.defaults
```kconfig
# ============================================================
# Target
# ============================================================
CONFIG_IDF_TARGET="esp32s3"

# ============================================================
# Flash  (Waveshare 4.3B: 16 MB QIO @ 80 MHz)
# ============================================================
CONFIG_ESPTOOLPY_FLASHSIZE_16MB=y
CONFIG_ESPTOOLPY_FLASHMODE_QIO=y
CONFIG_ESPTOOLPY_FLASHFREQ_80M=y

# ============================================================
# PSRAM  (8 MB OPI PSRAM on ESP32-S3-N16R8)
# ============================================================
CONFIG_SPIRAM=y
CONFIG_SPIRAM_MODE_OCT=y
CONFIG_SPIRAM_SPEED_80M=y
CONFIG_SPIRAM_USE_MALLOC=y
CONFIG_SPIRAM_MALLOC_ALWAYSINTERNAL=16384
CONFIG_SPIRAM_TRY_ALLOCATE_WIFI_LWIP=y
CONFIG_FREERTOS_TASK_CREATE_ALLOW_EXT_MEM=y

# ============================================================
# CPU  (240 MHz dual-core)
# ============================================================
CONFIG_ESP_DEFAULT_CPU_FREQ_MHZ_240=y

# ============================================================
# FreeRTOS
# ============================================================
CONFIG_FREERTOS_HZ=1000

# ============================================================
# Console — USB Serial/JTAG
# ============================================================
CONFIG_ESP_CONSOLE_USB_SERIAL_JTAG=y
CONFIG_ESP_CONSOLE_UART_DEFAULT=n
CONFIG_ESP_CONSOLE_SECONDARY_NONE=y

# ============================================================
# Logging
# ============================================================
CONFIG_LOG_DEFAULT_LEVEL_INFO=y
CONFIG_LOG_MAXIMUM_LEVEL_DEBUG=y
```
